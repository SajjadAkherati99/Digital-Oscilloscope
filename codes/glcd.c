#include "glcd.h"
#include "gpio.h"




Glcd_Config_st glcdConfig;            //Structure containing the selected LCD Configuration


uint8_t shadowBuffer[8][128];
uint8_t ARR_GlcdFont_U8[][7] = {
        {0x00,0x00,0x00,0x00,0x00,0xff,0xff}, /* Space 0x20 */
        {0x00,0x00,0x4f,0x00,0x00,0x00,0xff}, /* ! */
        {0x00,0x07,0x00,0x07,0x00,0x00,0xff}, /* " */
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        {0xff,0xff,0xff,0xff,0xff,0x00,0xff}, /*  0x80 */
};


static void glcd_SelectPage0(void);
static void glcd_SelectPage1(void);
void glcd_CmdWrite( uint8_t var_cmd_u8);
void glcd_DataWrite( uint8_t var_data_u8);
static void glcd_SendData(uint8_t dataByte);
void glcd_BusyCheck(void);


void GLCD_SetUp(
	      gpioPins_et RS,
        gpioPins_et RW,
        gpioPins_et EN,
	      gpioPins_et CS1,
        gpioPins_et CS2,
        gpioPins_et D0,
        gpioPins_et D1,
        gpioPins_et D2,
        gpioPins_et D3,
        gpioPins_et D4,
        gpioPins_et D5,
        gpioPins_et D6,
        gpioPins_et D7 )
{
	
    glcdConfig.RS = RS;
    glcdConfig.RW = RW;
    glcdConfig.EN = EN;
	  glcdConfig.CS1 = CS1;
    glcdConfig.CS2 = CS2;

    glcdConfig.D0 = D0;
    glcdConfig.D1 = D1;
    glcdConfig.D2 = D2;
    glcdConfig.D3 = D3;
    glcdConfig.D4 = D4;
    glcdConfig.D5 = D5;
    glcdConfig.D6 = D6;
    glcdConfig.D7 = D7;

    
    GPIO_PinDirection(CS1,OUTPUT);
    GPIO_PinDirection(CS2,OUTPUT);
    GPIO_PinDirection(RS,OUTPUT);
    GPIO_PinDirection(RW,OUTPUT);
    GPIO_PinDirection(EN,OUTPUT);

    GPIO_PinDirection(D0,OUTPUT);
    GPIO_PinDirection(D1,OUTPUT);
    GPIO_PinDirection(D2,OUTPUT);
    GPIO_PinDirection(D3,OUTPUT);
    GPIO_PinDirection(D4,OUTPUT);
    GPIO_PinDirection(D5,OUTPUT);
    GPIO_PinDirection(D6,OUTPUT);
    GPIO_PinDirection(D7,OUTPUT);  

}


void GLCD_Init()
{
    glcdConfig.LineNum = 0xB8;
    glcdConfig.PageNum = 0;
    glcdConfig.CursorPos = 0x40;
    glcd_SelectPage0();
    glcd_CmdWrite(0x3f);
    glcd_SelectPage1();
    glcd_CmdWrite(0x3f);
    DELAY_ms(10);

    glcd_SelectPage0();
    glcd_CmdWrite(0xc0);
    glcd_SelectPage1();
    glcd_CmdWrite(0xc0);
    GLCD_GoToPage(0);

    GLCD_Clear();
}

static void glcd_SelectPage0() 
{


    GPIO_PinWrite(glcdConfig.CS1,1);
    GPIO_PinWrite(glcdConfig.CS2,0);
    glcdConfig.PageNum=0;
}


static void glcd_SelectPage1() 
{

    GPIO_PinWrite(glcdConfig.CS1,0);
    GPIO_PinWrite(glcdConfig.CS2,1);

    glcdConfig.PageNum=1;

}


static void glcd_SendData(uint8_t dataByte)
{

    GPIO_PinWrite(glcdConfig.D0,((dataByte) & 0x01));
    GPIO_PinWrite(glcdConfig.D1,((dataByte >> 1) & 0x01));
    GPIO_PinWrite(glcdConfig.D2,((dataByte >> 2) & 0x01));
    GPIO_PinWrite(glcdConfig.D3,((dataByte >> 3) & 0x01));
    GPIO_PinWrite(glcdConfig.D4,((dataByte >> 4) & 0x01));
    GPIO_PinWrite(glcdConfig.D5,((dataByte >> 5) & 0x01));
    GPIO_PinWrite(glcdConfig.D6,((dataByte >> 6) & 0x01));
    GPIO_PinWrite(glcdConfig.D7,((dataByte >> 7) & 0x01));
}


void glcd_CmdWrite( uint8_t var_glcdCmd_u8)
{
    glcd_BusyCheck();
    glcd_SendData((var_glcdCmd_u8));

    GPIO_PinWrite(glcdConfig.RS,0);
    GPIO_PinWrite(glcdConfig.RW,0);
    GPIO_PinWrite(glcdConfig.EN,1);
    DELAY_us(1);
    GPIO_PinWrite(glcdConfig.EN,0);
    DELAY_us(1);
}


void glcd_DataWrite( uint8_t var_data_u8)
{
    uint8_t temp;

    glcd_BusyCheck();
    temp = var_data_u8; 
    glcd_SendData(temp);

    GPIO_PinWrite(glcdConfig.RS,1);
    GPIO_PinWrite(glcdConfig.RW,0);
    GPIO_PinWrite(glcdConfig.EN,1);
    DELAY_us(1);
    GPIO_PinWrite(glcdConfig.EN,0);
    DELAY_us(1);

    shadowBuffer[glcdConfig.LineNum-C_FirstLineNumberAddress_U8][(glcdConfig.PageNum*64)+glcdConfig.CursorPos] = var_data_u8;
    glcdConfig.CursorPos++;
    if((glcdConfig.PageNum == 0x01) && (glcdConfig.CursorPos==0x80))
        GLCD_GoToNextLine();
}


void glcd_BusyCheck()
{
    DELAY_us(10);
}

void GLCD_Clear()
{
    uint8_t line,cursor;

    for(line=0;line<8;line++)
    {
        GLCD_GoToLine(line);
        for(cursor=0;cursor<128;cursor++) 
        {
            if(cursor==64)  
            {
                GLCD_GoToPage(1); 
            }

            glcd_DataWrite(0x00);
        }
    }

    GLCD_GoToLine(0);
}


void GLCD_EnableDisplayInversion()
{
    glcdConfig.InvertDisplay = 0xff;
}



void GLCD_DisableDisplayInversion()
{
    glcdConfig.InvertDisplay = 0x00;
}



#if (ENABLE_GLCD_SetDot ==1)
void GLCD_SetDot(uint8_t var_x_u8, uint8_t var_y_u8, uint8_t var_color_u8)
{
    uint8_t v_dataRead_u8;

    if ((var_x_u8<128)&&(var_y_u8<64))				 
    {
        v_dataRead_u8 = GLCD_GetXYData(var_x_u8,var_y_u8);

        var_y_u8 = util_GetMod8(var_y_u8,8);		 

        if (var_color_u8)						
            util_BitSet(v_dataRead_u8,var_y_u8);
        else
            util_BitClear(v_dataRead_u8,var_y_u8);

        glcd_DataWrite(v_dataRead_u8^glcdConfig.InvertDisplay);
    }

}
#endif


#if (ENABLE_GLCD_DrawHoriLine == 1)
void GLCD_DrawHoriLine(uint8_t var_x_u8, uint8_t var_y_u8, uint8_t var_length_u8,uint8_t var_color_u8)
{

    if ((var_x_u8<128)&&(var_y_u8<64))					
    {
        var_length_u8++;
        while(var_length_u8)
        {

							GLCD_SetDot(var_x_u8,var_y_u8,var_color_u8);

            if ((glcdConfig.CursorPos >0x7F) && (glcdConfig.PageNum == 1)) 
                return;		   								 

            var_x_u8++;
            var_length_u8--;
        }
    }


}
#endif


#if ((ENABLE_GLCD_DrawVertLine ==1) || (ENABLE_GLCD_DrawLine==1))
void GLCD_DrawVertLine(uint8_t var_x_u8, uint8_t var_y_u8, uint8_t var_length_u8, uint8_t var_color_u8)
{

    if ((var_x_u8<128)&&(var_y_u8<64))				
    {
        while(var_length_u8)
        {
            GLCD_SetDot(var_x_u8,var_y_u8,var_color_u8);

            if (glcdConfig.LineNum > C_LastLineNumberAddress_U8)	
                return;

            var_y_u8++;
            var_length_u8--;            
        }
    }

}
#endif


#if (ENABLE_GLCD_GetXYData ==1)
uint8_t GLCD_GetXYData(uint8_t var_x_u8, uint8_t var_y_u8)
{
    uint8_t v_dataRead_u8 = 0;

    if ((var_x_u8<128)&&(var_y_u8<64))
    {
        if(var_x_u8 > 63) 
        {
            glcd_SelectPage1();
            glcdConfig.PageNum=1;
            glcdConfig.CursorPos= var_x_u8-64;
        }
        else
        {
            glcd_SelectPage0();
            glcdConfig.PageNum=0;
            glcdConfig.CursorPos= var_x_u8 ;
        }

        glcdConfig.LineNum=C_FirstLineNumberAddress_U8 + (var_y_u8 >> 3);	
        GLCD_SetCursor(glcdConfig.PageNum,glcdConfig.LineNum,glcdConfig.CursorPos);

        v_dataRead_u8 = GLCD_DataRead();
    }
    return (v_dataRead_u8);
}
#endif


void GLCD_GoToPage(uint8_t pageNumber)
{

    if((pageNumber==0) || (pageNumber ==1))
    { 
        if(pageNumber == 0)
        {

            glcd_SelectPage0();
        }
        else
        {
            glcd_SelectPage1();
        }
        glcdConfig.PageNum=pageNumber;
        glcdConfig.CursorPos=0x40;
        glcd_CmdWrite(glcdConfig.LineNum);
        glcd_CmdWrite(glcdConfig.CursorPos);
    }
}


void  GLCD_GoToNextLine()
{
    glcdConfig.LineNum++;
    if(glcdConfig.LineNum > C_LastLineNumberAddress_U8)
        glcdConfig.LineNum = C_FirstLineNumberAddress_U8;
    GLCD_GoToPage(0); 
}


#if (ENABLE_GLCD_DataRead ==1) 
uint8_t GLCD_DataRead(void)
{
    uint8_t v_dataRead_u8;

    v_dataRead_u8 = shadowBuffer[glcdConfig.LineNum-C_FirstLineNumberAddress_U8][(glcdConfig.PageNum*64)+glcdConfig.CursorPos];

    return(v_dataRead_u8);
}
#endif


void  GLCD_GoToLine(uint8_t var_lineNumber_u8)
{
    if(var_lineNumber_u8<8)
    {   
        glcdConfig.LineNum = var_lineNumber_u8+C_FirstLineNumberAddress_U8;
        GLCD_GoToPage(0);
    }
}


void GLCD_SetCursor(uint8_t pageNumber,uint8_t lineNumber,uint8_t CursorPosition)
{
    if(((pageNumber == 0x00)   || (pageNumber == 0x01)) && (lineNumber <= C_GlcdLastLine_U8) && (CursorPosition < 64) )
    {
        if(pageNumber==0x00) 
        {
            glcd_SelectPage0();
        }
        else
        {
            glcd_SelectPage1();
        }
    }

    glcdConfig.PageNum = pageNumber; 
    glcdConfig.LineNum=lineNumber | C_FirstLineNumberAddress_U8; 
    glcdConfig.CursorPos=CursorPosition |0x40; 

    glcd_CmdWrite(glcdConfig.CursorPos); 
    glcd_CmdWrite(glcdConfig.LineNum);
}

void GLCD_GetCursor(uint8_t *page_ptr,uint8_t *line_ptr,uint8_t *cursor_ptr)
{

    *page_ptr=glcdConfig.PageNum;
    *line_ptr=glcdConfig.LineNum - C_FirstLineNumberAddress_U8;
    *cursor_ptr=glcdConfig.CursorPos;
}

